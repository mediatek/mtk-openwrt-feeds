## autobuild/unified/filogic/25.12/defconfig
```kconfig
CONFIG_TARGET_MULTI_PROFILE=y
CONFIG_TARGET_PER_DEVICE_ROOTFS=y
CONFIG_TARGET_DEVICE_mediatek_filogic_DEVICE_bananapi_bpi-r4=y
CONFIG_TARGET_DEVICE_mediatek_filogic_DEVICE_bananapi_bpi-r4-poe=y
CONFIG_TARGET_DEVICE_mediatek_filogic_DEVICE_bananapi_bpi-r4-lite=y
CONFIG_TARGET_DEVICE_mediatek_filogic_DEVICE_bananapi_bpi-r4-mini=y
CONFIG_TARGET_DEVICE_mediatek_filogic_DEVICE_bananapi_bpi-r4-pro=y
CONFIG_TARGET_DEVICE_mediatek_filogic_DEVICE_mediatek_mt7981-rfb=y
CONFIG_TARGET_DEVICE_mediatek_filogic_DEVICE_mediatek_mt7986a-rfb=y
CONFIG_TARGET_DEVICE_mediatek_filogic_DEVICE_mediatek_mt7986b-rfb=y
CONFIG_TARGET_DEVICE_mediatek_filogic_DEVICE_mediatek_mt7987a-rfb=y
CONFIG_TARGET_DEVICE_mediatek_filogic_DEVICE_mediatek_mt7988a-rfb=y
CONFIG_TARGET_DEVICE_mediatek_filogic_DEVICE_mediatek_mt7988d-rfb=y
CONFIG_PACKAGE_block-mount=y
CONFIG_BUSYBOX_CUSTOM=y
CONFIG_BUSYBOX_CONFIG_TFTP=y
CONFIG_BUSYBOX_CONFIG_FEATURE_TFTP_GET=y
CONFIG_BUSYBOX_CONFIG_FEATURE_TFTP_PUT=y
CONFIG_BUSYBOX_CONFIG_VCONFIG=y
CONFIG_BUSYBOX_CONFIG_MPSTAT=y
CONFIG_PACKAGE_wifi-scripts=y
# CONFIG_PACKAGE_trusted-firmware-a-mt7981-ram-ddr3 is not set
# CONFIG_PACKAGE_trusted-firmware-a-mt7981-ram-ddr4 is not set
# CONFIG_PACKAGE_trusted-firmware-a-mt7986-ram-ddr3 is not set
# CONFIG_PACKAGE_trusted-firmware-a-mt7986-ram-ddr4 is not set
# CONFIG_PACKAGE_trusted-firmware-a-mt7987-ram-comb is not set
# CONFIG_PACKAGE_trusted-firmware-a-mt7988-ram-comb is not set
# CONFIG_PACKAGE_trusted-firmware-a-mt7988-ram-ddr4 is not set
CONFIG_PACKAGE_airoha-phy-firmware=y
CONFIG_PACKAGE_as2xxxx-firmware=y
CONFIG_PACKAGE_mt7981-wo-firmware=y
CONFIG_PACKAGE_wireless-regdb=y
CONFIG_PACKAGE_kmod-fs-ext4=y
CONFIG_PACKAGE_kmod-fs-f2fs=y
CONFIG_PACKAGE_kmod-fs-vfat=y
CONFIG_PACKAGE_kmod-ipt-conntrack=y
CONFIG_PACKAGE_kmod-ipt-extra=y
CONFIG_PACKAGE_kmod-ipt-nat=y
CONFIG_PACKAGE_kmod-ipt-offload=y
CONFIG_PACKAGE_kmod-mt798x-2p5g-phy=y
CONFIG_PACKAGE_kmod-phy-air_an8811hb=y
CONFIG_PACKAGE_kmod-phy-airoha-an8801sb=y
CONFIG_PACKAGE_kmod-phy-airoha-en8811h=y
CONFIG_PACKAGE_kmod-phy-aquantia=y
CONFIG_PACKAGE_kmod-phy-marvell=y
CONFIG_PACKAGE_kmod-phy-marvell-10g=y
CONFIG_PACKAGE_kmod-sfp=y
CONFIG_PACKAGE_kmod-usb-storage=y
CONFIG_PACKAGE_kmod-usb3=y
CONFIG_PACKAGE_luci=y
CONFIG_PACKAGE_luci-app-ksmbd=y
CONFIG_PACKAGE_regs=y
CONFIG_PACKAGE_ephy-utils=y
CONFIG_PACKAGE_mtk_factory_rw=y
CONFIG_PACKAGE_netsys_dbg_util=y
CONFIG_PACKAGE_lftp=y
CONFIG_PACKAGE_ip6tables-zz-legacy=y
CONFIG_PACKAGE_iptables-mod-ipopt=y
CONFIG_PACKAGE_iptables-zz-legacy=y
CONFIG_PACKAGE_ip-bridge=y
CONFIG_PACKAGE_ip-full=y
CONFIG_PACKAGE_pptpd=y
CONFIG_PACKAGE_xl2tpd=y
CONFIG_PACKAGE_ethtool-full=y
CONFIG_PACKAGE_iperf3=y
CONFIG_PACKAGE_iw=y
CONFIG_PACKAGE_mtkhnat_util=y
CONFIG_PACKAGE_ppp-mod-pptp=y
CONFIG_PACKAGE_tcpdump=y
CONFIG_PACKAGE_fio=y
CONFIG_PACKAGE_lsblk=y
CONFIG_PACKAGE_sfdisk=y
CONFIG_PACKAGE_gpiod-tools=y
CONFIG_PACKAGE_i2c-tools=y
CONFIG_PACKAGE_iio-utils=y
CONFIG_PACKAGE_lm-sensors=y
CONFIG_PACKAGE_mmc-utils=y
CONFIG_PACKAGE_pciutils=y
CONFIG_PACKAGE_spidev-test=y
CONFIG_PACKAGE_usbutils=y
CONFIG_PACKAGE_smp_util=y
```

## autobuild/unified/filogic/25.12/files/target/linux/mediatek/image/Config.in
```kconfig
menuconfig MTK_SECURE_BOOT
	bool "Enable Secure Boot"
	select PACKAGE_dmsetup
	select PACKAGE_cryptsetup
	select PACKAGE_secure-upgrade-utils
	default n
	help
	  Select mtk secure boot

if MTK_SECURE_BOOT

config SBC_KEY_DIR
	string "secure boot key directory"
	default "../../keys"

choice
	prompt "Secure Boot Profile"
	default SBC_PROFILE_CLASSICAL

	config SBC_PROFILE_CLASSICAL
		bool "Classical (RSA/ECC)"

	config SBC_PROFILE_PQC
		bool "PQC (ML-DSA)"

	config SBC_PROFILE_HYBRID
		bool "Hybrid (Classical + PQC)"
endchoice

if SBC_PROFILE_CLASSICAL || SBC_PROFILE_HYBRID

config FIT_SIGN_KEY_NAME
	string "FIT sign key name"
	default "fit_key"

config FIT_SIGN_ALG
	string "FIT sign algorithm"
	default "sha256,rsa2048"

endif # SBC_PROFILE_CLASSICAL || SBC_PROFILE_HYBRID

if SBC_PROFILE_PQC || SBC_PROFILE_HYBRID

config FIT_PQC_SIGN_KEY_NAME
	string "FIT PQC sign key name"
	default "fit_pqc_key"

config FIT_PQC_SIGN_ALG
	string "FIT sign PQC algorithm"
	default "sha512,mldsa87"

endif # SBC_PROFILE_PQC || SBC_PROFILE_HYBRID

menu "Firmware Encryption"

config MTK_FW_ENC
	bool "Enable firmware encryption"
	default n
	help
	  Select mtk firmware encryption

config MTK_TA_ENC
	bool "Enable TA encryption"
	default n
	select OPTEE_ENCRYPT_TA
	help
	  Enable TA encryption

if MTK_FW_ENC

choice
	prompt "Choose rootfs encryption method"
	default MTK_FW_ENC_USE_RAMDISK

config MTK_FW_ENC_USE_RAMDISK
	bool "use RAM disk"
	select KERNEL_BLK_DEV_RAM
	help
	  decrypt the whold rootfs to RAM, and mounting as RAM disk

endchoice

choice
	prompt "Choose firmware decryption backend"
	default FW_ENC_DECRYPT_VIA_BL32

config FW_ENC_DECRYPT_VIA_BL31
	bool "Decrypt firmware via BL31"

config FW_ENC_DECRYPT_VIA_BL32
	bool "Decrypt firmware via BL32"
	select PACKAGE_optee-apps
	select OPTEE_FW_ENC_EARLY_TA
endchoice

config FW_ENC_ALG
	string
	default "tee_aes256" if FW_ENC_DECRYPT_VIA_BL31
	default "optee_aes256" if FW_ENC_DECRYPT_VIA_BL32

endif # MTK_FW_ENC


config PLAT_KEY_NAME
	string "platform key name"
	default "plat_key"
	depends on MTK_FW_ENC || MTK_TA_ENC

config ROE_SALT
	string "ROE key salt"
	default "salt/roe_salt.bin"
	depends on MTK_FW_ENC || MTK_TA_ENC

config KERNEL_SALT
	string "Kernel encryption key salt"
	default "salt/kernel_salt.bin"
	depends on MTK_FW_ENC

config ROOTFS_SALT
	string "Rootfs encryption key salt"
	default "salt/rootfs_salt.bin"
	depends on MTK_FW_ENC

config TA_SALT
	string "TA encryption key salt"
	default "salt/ta_salt.bin"
	depends on MTK_TA_ENC
endmenu

menuconfig MTK_ANTI_ROLLBACK
	bool "Enable Anti-Rollback"
	default n
	help
	  Select mtk anti-rollback

if MTK_ANTI_ROLLBACK

config ANTI_ROLLBACK_TABLE
	string "Anti-Rollback table"
	default "../../fw_ar_table.xml"

config AUTO_AR_CONF
	string "Anti-Rollback auto config"
	default "auto_ar_conf.mk"

endif # MTK_ANTI_ROLLBACK

endif # MTK_SECURE_BOOT
```

## autobuild/unified/filogic/mac80211/mt7988_rfb/24.10/defconfig
```kconfig
CONFIG_TARGET_PER_DEVICE_ROOTFS=y
CONFIG_TARGET_DEVICE_mediatek_filogic_DEVICE_bananapi_bpi-r4=y
CONFIG_TARGET_DEVICE_mediatek_filogic_DEVICE_bananapi_bpi-r4-poe=y
CONFIG_TARGET_DEVICE_mediatek_filogic_DEVICE_bananapi_bpi-r4-pro=y
# CONFIG_TARGET_DEVICE_mediatek_filogic_DEVICE_mediatek_mt7981-rfb is not set
# CONFIG_TARGET_DEVICE_mediatek_filogic_DEVICE_mediatek_mt7986a-rfb-nand is not set
CONFIG_TARGET_DEVICE_mediatek_filogic_DEVICE_mediatek_mt7988a-rfb-mxl86252=y
CONFIG_TARGET_DEVICE_mediatek_filogic_DEVICE_mediatek_mt7988d-rfb=y
# CONFIG_TARGET_DEVICE_mediatek_filogic_DEVICE_mediatek_mt7986b-rfb is not set
CONFIG_PACKAGE_aqr10g-phy-firmware=y
CONFIG_PACKAGE_as2xxxx-firmware=y
CONFIG_PACKAGE_mt798x-2p5g-phy-firmware-internal=y
CONFIG_PACKAGE_kmod-gpio-pcf857x=y
CONFIG_PACKAGE_kmod-hwmon-ina2xx=y
CONFIG_PACKAGE_kmod-sfp=y
CONFIG_PACKAGE_kmod-usb3=y
CONFIG_PACKAGE_blkid=y
CONFIG_PACKAGE_e2fsprogs=y
CONFIG_PACKAGE_f2fsck=y
CONFIG_PACKAGE_mkf2fs=y
```

## autobuild/unified/filogic/mac80211/mt798x_rfb/wifi8_nic/25.12/defconfig
```kconfig
# CONFIG_TARGET_DEVICE_mediatek_filogic_DEVICE_mediatek_mt7981-rfb is not set
# CONFIG_TARGET_DEVICE_mediatek_filogic_DEVICE_mediatek_mt7986a-rfb is not set
# CONFIG_TARGET_DEVICE_mediatek_filogic_DEVICE_mediatek_mt7986b-rfb is not set
# CONFIG_PACKAGE_mt7981-wo-firmware is not set
# CONFIG_PACKAGE_mt7986-wo-firmware is not set
# CONFIG_PACKAGE_kmod-mt7915e is not set
# CONFIG_PACKAGE_kmod-mt7981-firmware is not set
# CONFIG_PACKAGE_kmod-mt7986-firmware is not set
# CONFIG_PACKAGE_kmod-mt7990-firmware is not set
# CONFIG_PACKAGE_kmod-mt7992-23-firmware is not set
# CONFIG_PACKAGE_kmod-mt7992-firmware is not set
# CONFIG_PACKAGE_kmod-mt7996-233-firmware is not set
# CONFIG_PACKAGE_kmod-mt7996e is not set
CONFIG_PACKAGE_kmod-mt7999-firmware=y
```
